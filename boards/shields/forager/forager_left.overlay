#include "forager.dtsi"

&kscan0 {
   col-gpios
   = <&gpio0 2 GPIO_ACTIVE_HIGH>
   , <&gpio0 3 GPIO_ACTIVE_HIGH>
   , <&gpio0 28 GPIO_ACTIVE_HIGH>
   , <&gpio0 29 GPIO_ACTIVE_HIGH>
   , <&gpio0 4 GPIO_ACTIVE_HIGH>
   ;

   row-gpios
   = <&gpio1 11 (GPIO_ACTIVE_HIGH | GPIO_PULL_DOWN)>
   , <&gpio1 13 (GPIO_ACTIVE_HIGH | GPIO_PULL_DOWN)>
   , <&gpio1 12 (GPIO_ACTIVE_HIGH | GPIO_PULL_DOWN)>
   , <&gpio1 14 (GPIO_ACTIVE_HIGH | GPIO_PULL_DOWN)>
   ;
};

// The halves are XIAOs, whose UART is unused. This lives in the half overlays
// rather than forager.dtsi because the dongle also includes forager.dtsi, and
// it is a nice!nano with no xiao_serial node.
&xiao_serial {
    status = "disabled";
};
